## meta-custom-games/conf/layer.conf
```bitbake
# We have a conf and classes directory, add to BBPATH
BBPATH .= ":${LAYERDIR}"

# We have recipes-* directories, add to BBFILES
BBFILES += "${LAYERDIR}/recipes-*/*/*.bb \
            ${LAYERDIR}/recipes-*/*/*.bbappend"

BBFILE_COLLECTIONS += "meta-custom-games"
BBFILE_PATTERN_meta-custom-games = "^${LAYERDIR}/"
BBFILE_PRIORITY_meta-custom-games = "6"

LAYERDEPENDS_meta-custom-games = "core"
LAYERSERIES_COMPAT_meta-custom-games = "scarthgap"
```

## meta-my-retro/conf/distro/my-retro-os.conf
```bitbake
require conf/distro/poky.conf

DISTRO = "my-retro-os"
DISTRO_NAME = "My Retro OS"
DISTRO_VERSION = "1.0"

DISTRO_FEATURES:append = " gles2 retroarch-gles retroarch-gles3 alsa bluetooth bluez5"
INIT_MANAGER = "systemd"

LICENSE_FLAGS_ACCEPTED += "commercial synaptics-killswitch"

# Load ps5 controller kernel module
KERNEL_MODULE_AUTOLOAD += "hid-playstation"

# Enable bluetooth service
SYSTEMD_AUTO_ENABLE:pn-bluez5 = "enable"

# Ensure the bluetooth directory is not wiped if you use a persistent partition
VOLATILE_BINDS:append = " /data/lib/bluetooth /var/lib/bluetooth\n"

# Root login
EXTRA_IMAGE_FEATURES += "debug-tweaks"
```

## meta-my-retro/conf/layer.conf
```bitbake
# We have a conf and classes directory, add to BBPATH
BBPATH .= ":${LAYERDIR}"

# We have recipes-* directories, add to BBFILES
BBFILES += "${LAYERDIR}/recipes-*/*/*.bb \
            ${LAYERDIR}/recipes-*/*/*.bbappend"

BBFILE_COLLECTIONS += "meta-my-retro"
BBFILE_PATTERN_meta-my-retro = "^${LAYERDIR}/"
BBFILE_PRIORITY_meta-my-retro = "10"

LAYERDEPENDS_meta-my-retro = "core"
LAYERSERIES_COMPAT_meta-my-retro = "scarthgap"
```

## meta-webserver-stream/conf/layer.conf
```bitbake
# We have a conf and classes directory, add to BBPATH
BBPATH .= ":${LAYERDIR}"

# We have recipes-* directories, add to BBFILES
BBFILES += "${LAYERDIR}/recipes-*/*/*.bb \
            ${LAYERDIR}/recipes-*/*/*.bbappend"

BBFILE_COLLECTIONS += "meta-webserver-stream"
BBFILE_PATTERN_meta-webserver-stream = "^${LAYERDIR}/"
BBFILE_PRIORITY_meta-webserver-stream = "10"

LAYERDEPENDS_meta-webserver-stream = "core meta-python"
LAYERSERIES_COMPAT_meta-webserver-stream = "scarthgap"
```
